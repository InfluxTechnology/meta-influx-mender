## conf/layer.conf
```bitbake
# We have a conf and classes directory, add to BBPATH
BBPATH .= ":${LAYERDIR}"

# We have a recipes directory, add to BBFILES
BBFILES += "${LAYERDIR}/recipes-*/*/*.bb \
            ${LAYERDIR}/recipes-*/*/*.bbappend"

BBFILE_COLLECTIONS += "inf-mender"
BBFILE_PATTERN_inf-mender = "^${LAYERDIR}/"
BBFILE_PRIORITY_inf-mender = "11"
LAYERSERIES_COMPAT_inf-mender = "mickledore"

LAYERDEPENDS_mender-coral = "mender inf"
```
